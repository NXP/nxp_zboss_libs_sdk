## CMakeLists.txt
```
# SPDX-License-Identifier: Apache-2.0

cmake_minimum_required(VERSION 3.20.0)

find_package(Zephyr REQUIRED HINTS $ENV{ZEPHYR_BASE})
project(bulb)

target_sources(app PRIVATE
	       src/bulb.c
	       src/bulb_hal.c
	       )
```

## sample.yaml
```
sample:
  name: bulb
  description: >
    sample application demonstrating Zigbee functionality for NXP ZBOSS stack
  common:
    min_ram: 32
    min_flash: 256
    tags: zboss
    depends_on: zboss

tests:
  sample.zboss.basic:
    tags: zboss
    harness: console
    harness_config:
      type: one_line
      regex:
        - "Zboss (.*)"
    platform_allow:
      - frdm_mcxw71
      - frdm_mcxw72
      - frdm_rw612
```

## prj.conf
```kconfig
# Zigbee Zboss Application

# OS
CONFIG_EVENTS=y
CONFIG_HEAP_MEM_POOL_SIZE=16384
CONFIG_MAIN_STACK_SIZE=6144
# Must be higher that MAC_INTF_CB_TASK_PRIORITY, refer to:
# modules/hal/nxp/mcux/middleware/mcux-sdk-middleware-ieee_802.15.4/ieee_802_15_4/mac/source/App/mac_intf_rpmsg.c
CONFIG_MAIN_THREAD_PRIORITY=5

# Enable NVMEM subsystem
CONFIG_NVMEM=y
CONFIG_NVMEM_FLASH=y
#CONFIG_LOG=y
#CONFIG_NVMEM_LOG_LEVEL_DBG=y

# Flash
CONFIG_FLASH=y
CONFIG_FLASH_MAP=y
CONFIG_FLASH_PAGE_LAYOUT=y

CONFIG_NVS=y
#CONFIG_LOG=y
#CONFIG_NVS_LOG_LEVEL_DBG=y

CONFIG_TEST_RANDOM_GENERATOR=y

CONFIG_REBOOT=y
CONFIG_ASSERT=y

CONFIG_NXP_RF_IMU=y
CONFIG_NXP_IEEE802154_MAC=y

CONFIG_DEBUG=y

CONFIG_FPU=y
CONFIG_FP_HARDABI=y

# ZBOSS module
CONFIG_ZBOSS=y
CONFIG_ZBOSS_LOGS_ON_UART=n

CONFIG_ENTROPY_GENERATOR=y
CONFIG_ENTROPY_NXP_ELE_TRNG=y

# End of common configs 

# ZBOSS device role (sample-specific)
CONFIG_ZBOSS_ROLE_ZR=y
```

## src/bulb.h
```c
/* ZBOSS Zigbee software protocol stack
 *
 * Copyright (c) 2012-2020 DSR Corporation, Denver CO, USA.
 * www.dsr-zboss.com
 * www.dsr-corporation.com
 * All rights reserved.
 *
 * Copyright 2024, 2026 NXP
 *
 * This is unpublished proprietary source code of DSR Corporation
 * The copyright notice does not evidence any actual or intended
 * publication of such source code.
 *
 * ZBOSS is a registered trademark of Data Storage Research LLC d/b/a DSR
 * Corporation
 *
 * Commercial Usage
 * Licensees holding valid DSR Commercial licenses may use
 * this file in accordance with the DSR Commercial License
 * Agreement provided with the Software or, alternatively, in accordance
 * with the terms contained in a written agreement between you and
 * DSR.
 */
/* PURPOSE: Header file for led bulb sample application for HA
*/

#ifndef BULB_H
#define BULB_H 1

#include "zboss_api.h"

/* ZDD capability is not available in case of undefined ZB_DIRECT_ENABLED */
#if !defined(ZB_DIRECT_ENABLED)
#undef DIMMABLE_LIGHT_ENABLE_ZDD
#endif /* !ZB_DIRECT_ENABLED */

#ifdef DIMMABLE_LIGHT_ENABLE_ZDD
#include "bulb_zdd.h"
#endif /* DIMMABLE_LIGHT_ENABLE_ZDD */

/* Bulb IEEE address */
#define BULB_IEEE_ADDRESS {0x00, 0x00, 0x00, 0x00, 0x01, 0x00, 0x00, 0x00}
/* major app version */
#define BULB_FIRMWARE_MAJOR       1
/* Application manufacturer code */
#define BULB_FIRMWARE_MANUF_CODE  2
/* BULB app revision (minor ver) */
#define BULB_FIRMWARE_MINOR       0
/* Default channel */
/* default ZIGBEE channel */
#ifndef CONFIG_ZIGBEE_CHANNEL
#define CONFIG_ZIGBEE_CHANNEL 21
#endif
#define BULB_DEFAULT_APS_CHANNEL_MASK (1l<<CONFIG_ZIGBEE_CHANNEL)
/* Used endpoint number */
#define HA_DIMMABLE_LIGHT_ENDPOINT 10

/* Handler for specific ZCL commands */
zb_uint8_t zcl_specific_cluster_cmd_handler(zb_uint8_t param);

/* Light Bulb initialization */
void bulb_device_app_init(zb_uint8_t param);
/* Initialization of global device context */
void bulb_app_ctx_init();
/* Initialization of HA attributes */
void bulb_clusters_attr_init(zb_uint8_t param);
/* Device user application callback */
void test_device_cb(zb_uint8_t param);
/* Set default value all attribute" callback */
void zcl_reset_to_defaults_cb(zb_uint8_t param);

/* Update current level value in the global context */
zb_ret_t level_control_set_level(zb_uint8_t new_level);
/* Start identifying for hardware */
void bulb_do_identify(zb_uint8_t param);

/* [app_nvram_cb_proto] */
/* Application callback for writing application data to NVRAM */
zb_ret_t bulb_nvram_write_app_data(zb_uint8_t page, zb_uint32_t pos);
/* Application callback for reading application data from NVRAM */
void bulb_nvram_read_app_data(zb_uint8_t page, zb_uint32_t pos, zb_uint16_t payload_length);
/* Application callback to determine application NVRAM stored dataset size */
zb_uint16_t bulb_get_nvram_data_size();
/* [app_nvram_cb_proto] */

/* attributes of Basic cluster */
typedef struct bulb_device_basic_attr_s
{
  zb_uint8_t zcl_version;
  zb_uint8_t app_version;
  zb_uint8_t stack_version;
  zb_uint8_t hw_version;
  zb_char_t mf_name[32];
  zb_char_t model_id[32];
  zb_char_t date_code[16];
  zb_uint8_t power_source;
  zb_char_t location_id[17];
  zb_uint8_t ph_env;
  zb_char_t sw_build_id[3];
}
bulb_device_basic_attr_t;

/* Basic cluster attributes data */
#define BULB_INIT_BASIC_STACK_VERSION     BULB_FIRMWARE_MAJOR           /* define major app version */
#define BULB_INIT_BASIC_HW_VERSION        BULB_FIRMWARE_MANUF_CODE      /* define manufacturer code */
#define BULB_INIT_BASIC_APP_VERSION       BULB_FIRMWARE_MINOR           /* define f/w revision */

#define BULB_INIT_BASIC_MANUF_NAME	  "DSR"

/* Note: instead of the 1st space string len will be set */
#define BULB_INIT_BASIC_MODEL_ID     "Dim_Light"
#define BULB_INIT_BASIC_DATE_CODE    "2016-05-25"
#define BULB_INIT_BASIC_LOCATION_ID  "CH"
#define BULB_INIT_BASIC_PH_ENV                            0

/* attributes of Identify cluster */
typedef struct bulb_device_identify_attr_s
{
  zb_uint16_t identify_time;
}
bulb_device_identify_attr_t;

/* attributes of ON/Off cluster */
typedef struct bulb_device_on_off_attr_s
{
  zb_bool_t on_off;
}
bulb_device_on_off_attr_t;

/* attributes of Level Control cluster */
typedef struct bulb_device_level_control_attr_s
{
  zb_uint8_t current_level;
  zb_uint16_t remaining_time;
}
bulb_device_level_control_attr_t;

/* Global device context */
typedef struct bulb_device_ctx_s
{
  bulb_device_basic_attr_t basic_attr;
  bulb_device_identify_attr_t identify_attr;
  bulb_device_on_off_attr_t on_off_attr;
  bulb_device_level_control_attr_t level_control_attr;
}
bulb_device_ctx_t;

/* [app_nvram_define_dataset] */
/* Application dataset for persisting into nvram */
typedef ZB_PACKED_PRE struct bulb_device_nvram_dataset_s
{
  zb_uint8_t onoff_state;
  zb_uint8_t current_level;
  /* Size of the structure in bytes must be divisible by 4 */
  zb_uint8_t reserved[2];
} ZB_PACKED_STRUCT
bulb_device_nvram_dataset_t;
/* [app_nvram_define_dataset] */

#endif /* BULB_H */
```
