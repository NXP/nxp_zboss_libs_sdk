## CMakeLists.txt
```
# SPDX-License-Identifier: Apache-2.0

cmake_minimum_required(VERSION 3.20.0)

find_package(Zephyr REQUIRED HINTS $ENV{ZEPHYR_BASE})
project(light_zc)

target_sources(app PRIVATE
	       src/light_zc.c
	       src/light_zc_hal.c
	       )
```

## sample.yaml
```
sample:
  name: light_zc
  description: >
    sample application demonstrating Zigbee functionality for NXP ZBOSS stack
  common:
    min_ram: 32
    min_flash: 256
    tags: zboss
    depends_on: zboss

tests:
  sample.zboss.basic:
    tags: zboss
    harness: console
    harness_config:
      type: one_line
      regex:
        - "Zboss (.*)"
    platform_allow:
      - frdm_mcxw71
      - frdm_mcxw72
      - frdm_rw612
```

## prj.conf
```kconfig
# Zigbee Zboss Application

# OS
CONFIG_EVENTS=y
CONFIG_HEAP_MEM_POOL_SIZE=16384
CONFIG_MAIN_STACK_SIZE=6144
# Must be higher that MAC_INTF_CB_TASK_PRIORITY, refer to:
# modules/hal/nxp/mcux/middleware/mcux-sdk-middleware-ieee_802.15.4/ieee_802_15_4/mac/source/App/mac_intf_rpmsg.c
CONFIG_MAIN_THREAD_PRIORITY=5

# Enable NVMEM subsystem
CONFIG_NVMEM=y
CONFIG_NVMEM_FLASH=y
#CONFIG_LOG=y
#CONFIG_NVMEM_LOG_LEVEL_DBG=y

# Flash
CONFIG_FLASH=y
CONFIG_FLASH_MAP=y
CONFIG_FLASH_PAGE_LAYOUT=y

CONFIG_NVS=y
#CONFIG_LOG=y
#CONFIG_NVS_LOG_LEVEL_DBG=y

CONFIG_TEST_RANDOM_GENERATOR=y

CONFIG_REBOOT=y
CONFIG_ASSERT=y

CONFIG_NXP_RF_IMU=y
CONFIG_NXP_IEEE802154_MAC=y

CONFIG_DEBUG=y

CONFIG_FPU=y
CONFIG_FP_HARDABI=y

# ZBOSS module
CONFIG_ZBOSS=y
CONFIG_ZBOSS_LOGS_ON_UART=n

CONFIG_ENTROPY_GENERATOR=y
CONFIG_ENTROPY_NXP_ELE_TRNG=y

# End of common configs 

# ZBOSS device role (sample-specific)
CONFIG_ZBOSS_ROLE_ZC=y
```

## src/light_zc.c
```c
/* ZBOSS Zigbee software protocol stack
 *
 * Copyright (c) 2012-2020 DSR Corporation, Denver CO, USA.
 * www.dsr-zboss.com
 * www.dsr-corporation.com
 * All rights reserved.
 *
 * Copyright 2026 NXP
 *
 * This is unpublished proprietary source code of DSR Corporation
 * The copyright notice does not evidence any actual or intended
 * publication of such source code.
 *
 * ZBOSS is a registered trademark of Data Storage Research LLC d/b/a DSR
 * Corporation
 *
 * Commercial Usage
 * Licensees holding valid DSR Commercial licenses may use
 * this file in accordance with the DSR Commercial License
 * Agreement provided with the Software or, alternatively, in accordance
 * with the terms contained in a written agreement between you and
 * DSR.
 */
/* PURPOSE: Light Coordinator
*/

#define ZB_TRACE_FILE_ID 40139
#include "light_zc.h"
#ifdef ZB_USE_BUTTONS
#include "light_zc_hal.h"
#endif

#ifndef ZB_COORDINATOR_ROLE
#error Coordinator role is not compiled!
#endif

#ifdef ZC_AUTO_SEARCH_AND_BIND
light_zc_ctx_t zc_ctx; /* Global device context */
#endif

zb_ieee_addr_t g_zc_addr = LIGHT_ZC_ADDRESS; /* IEEE address of the device */

#ifdef ZC_AUTO_SEARCH_AND_BIND
static void cleanup_dev(simple_device_t *dev)
{
  ZB_BZERO(dev, sizeof(simple_device_t));
  dev->last_zdo_tsn = 0xFF;
  dev->assign_idx = 0xFF;

  {
    zb_uint8_t j;

    for (j = 0; j < (LIGHT_ZC_MAX_DEVICES - 1); ++j)
    {
      dev->assign_table[j] = 0xFF;
    }
  }
}

static void cleanup_assign_table(simple_device_t *dev)
{
  zb_uint8_t i;
  zb_uint8_t dev_idx = ZB_ARRAY_IDX_BY_ELEM(zc_ctx.devices, dev);

  TRACE_MSG(TRACE_APP1, "cleanup assign table dev at idx: %hd", (FMT__H, dev_idx));

  for (i = 0; i < LIGHT_ZC_MAX_DEVICES; ++i)
  {
    zb_uint8_t j;

    for (j = 0; j < (LIGHT_ZC_MAX_DEVICES - 1); ++j)
    {
      if (zc_ctx.devices[i].assign_table[j] == dev_idx)
      {
        //TODO: send unbind request
        zc_ctx.devices[i].assign_table[j] = 0xFF;
      }
    }
  }
}

static void init_ctx(void)
{
  zb_uint8_t i;

  ZB_BZERO(&zc_ctx, sizeof(zc_ctx));

  for (i = 0; i < LIGHT_ZC_MAX_DEVICES; ++i)
  {
    cleanup_dev(&zc_ctx.devices[i]);
  }
}

#endif  /* ZC_AUTO_SEARCH_AND_BIND */

MAIN()
{
  ARGV_UNUSED;

  /* Trace enable */
  ZB_SET_TRACE_ON();
  /* Traffic dump enable */
  ZB_SET_TRAF_DUMP_ON();

  /* Initialization of the global device context */
#ifdef ZC_AUTO_SEARCH_AND_BIND
  init_ctx();
#endif

  /* Global ZBOSS initialization */
  ZB_INIT("light_zc");

/* HAL initialisation for hardware */
#ifdef ZB_USE_BUTTONS
  light_zc_hal_init();
#endif

  /* Set up defaults for the commissioning */
  zb_set_long_address(g_zc_addr);
#ifndef ZB_APP_ENABLE_SUBGHZ_MODE 
  {
    zb_set_network_coordinator_role(LIGHT_ZC_CHANNEL_MASK);
  }
#else
  {
    zb_channel_list_t channel_list;
    zb_channel_list_init(channel_list);
    zb_channel_page_list_set_mask(channel_list, (ZB_CHANNEL_LIST_PAGE28_IDX), (1l << 24));
    zb_set_network_coordinator_role_ext(channel_list);
  }
#endif
  zb_nwk_set_max_ed_capacity(5);

#ifdef ZB_USE_BUTTONS
  /* Erase NVRAM if BUTTON2 is pressed on start */
  zb_set_nvram_erase_at_start(light_zc_hal_is_button_pressed(LIGHT_ZC_BUTTON_2_IDX));
#else
  /*
  Do not erase NVRAM to save the network parameters after device reboot or power-off
  NOTE: If this option is set to ZB_FALSE then do full device erase for all network
  devices before running other samples.
  */
  zb_set_nvram_erase_at_start(ZB_FALSE);
#endif

#ifdef ZB_SUPPORT_LEGACY_DEVICES
  zb_bdb_set_legacy_device_support(ZB_TRUE);
#endif

#ifdef ZB_PLATFORM_ZEPHYR
  /* Zigbee 3.0 compliant device */
  zboss_use_r22_behavior();
#endif

  /* Initiate the stack start with starting the commissioning */
  if (zboss_start() != RET_OK)
  {
    TRACE_MSG(TRACE_ERROR, "zdo_dev_start failed", (FMT__0));
  }
  else
  {
    /* Call the main loop */
    zboss_main_loop();
  }

  /* Deinitialize trace */
  TRACE_DEINIT();

  MAIN_RETURN(0);
}

#ifdef ZC_AUTO_SEARCH_AND_BIND

static simple_device_t* device_find_by_zdo_tsn(zb_uint8_t zdo_tsn)
{
  zb_uint8_t i;

  for (i = 0; i < LIGHT_ZC_MAX_DEVICES; ++i)
  {
    if (zc_ctx.devices[i].last_zdo_tsn == zdo_tsn)
    {
      TRACE_MSG(TRACE_APP1, "found device by tsn: %hd", (FMT__H, zdo_tsn));
      return &zc_ctx.devices[i];
    }
  }

  TRACE_MSG(TRACE_ERROR, "find device by tsn: %hd failed", (FMT__H, zdo_tsn));
  return NULL;
}

static zb_ret_t device_bind(zb_uint8_t       buf_ref,
                            simple_device_t *dev,
                            simple_device_t *light,
                            simple_device_t *light_control);
static void device_assign(zb_uint8_t buf_ref, zb_uint16_t dev_idx);

static void device_bind_cb(zb_uint8_t buf_ref)
{
  zb_bufid_t buf = buf_ref;
  zb_zdo_bind_resp_t *resp = (zb_zdo_bind_resp_t *)zb_buf_begin(buf);
  simple_device_t    *dev;

  TRACE_MSG(TRACE_APP1, "> device_bind_cb buf_ref %hd", (FMT__H, buf_ref));

  dev = device_find_by_zdo_tsn(resp->tsn);

  if (dev != NULL)
  {
    dev->last_zdo_tsn = 0xFF;

#ifdef ZC_AUTO_SEARCH_AND_BIND_LVL_CTRL_CLST
    if (dev->bind_step == BIND_STEP_ON_OFF_CLST)
    {
      dev->bind_step = BIND_STEP_LVL_CTRL_CLST;

      {
        zb_ret_t ret;

        if (dev->dev_type == SIMPLE_DEV_TYPE_LIGHT)
        {
          ret = device_bind(buf_ref, dev, dev, &zc_ctx.devices[dev->assign_table[dev->assign_idx]]);
        }
        else
        {
          ret = device_bind(buf_ref, dev, &zc_ctx.devices[dev->assign_table[dev->assign_idx]], dev);
        }

        if (ret == RET_IGNORE)
        {
          dev->assign_idx = 0;
          device_assign(buf_ref, ZB_ARRAY_IDX_BY_ELEM(zc_ctx.devices, dev));
          buf_ref = 0;
        }
        else
        if (ret == RET_ERROR)
        {

        }
        else
        if (ret == RET_OK)
        {
          buf_ref = 0;
        }
        else
        {
          ZB_ASSERT(0);
        }
      }
    }
    else
#endif
    {
      dev->assign_idx = 0;
      device_assign(buf_ref, ZB_ARRAY_IDX_BY_ELEM(zc_ctx.devices, dev));
      buf_ref = 0;
    }
  }

  if (buf_ref)
  {
    zb_buf_free(buf);
  }

  TRACE_MSG(TRACE_APP1, "< device_bind_cb", (FMT__0));
}

static zb_ret_t device_bind(zb_uint8_t       buf_ref,
                            simple_device_t *dev,
                            simple_device_t *light,
                            simple_device_t *light_control)
{
  zb_bufid_t buf = buf_ref;
  zb_zdo_bind_req_param_t *bind_param = ZB_BUF_GET_PARAM(buf, zb_zdo_bind_req_param_t);

  TRACE_MSG(TRACE_APP1, "dev_idx: %hd light idx %hd light_control idx %hd",
            (FMT__H_H_H, ZB_ARRAY_IDX_BY_ELEM(zc_ctx.devices, dev),
             ZB_ARRAY_IDX_BY_ELEM(zc_ctx.devices, light),
             ZB_ARRAY_IDX_BY_ELEM(zc_ctx.devices, light_control)));

  switch (dev->bind_step)
  {
    case BIND_STEP_ON_OFF_CLST:
      bind_param->cluster_id = ZB_ZCL_CLUSTER_ID_ON_OFF;
      break;
#ifdef ZC_AUTO_SEARCH_AND_BIND_LVL_CTRL_CLST
    case BIND_STEP_LVL_CTRL_CLST:
      bind_param->cluster_id = ZB_ZCL_CLUSTER_ID_LEVEL_CONTROL;
      break;
#endif
    default:
      ZB_ASSERT(0);
      break;
  }

  /* light as destination */
  ZB_IEEE_ADDR_COPY(bind_param->dst_address.addr_long, light->ieee_addr);
  bind_param->dst_endp = light->match_ep;
  bind_param->dst_addr_mode = ZB_APS_ADDR_MODE_64_ENDP_PRESENT;
  TRACE_MSG(TRACE_APP1, "bind dst: ep %hd ieee_addr " TRACE_FORMAT_64, (FMT__H_A, bind_param->dst_endp, TRACE_ARG_64(bind_param->dst_address.addr_long)));

  /* light control as source */
  ZB_IEEE_ADDR_COPY(bind_param->src_address, light_control->ieee_addr);
  bind_param->src_endp = light_control->match_ep;
  bind_param->req_dst_addr = light_control->short_addr;
  TRACE_MSG(TRACE_APP1, "bind src: ep %hd ieee_addr " TRACE_FORMAT_64, (FMT__H_A, bind_param->src_endp, TRACE_ARG_64(bind_param->src_address)));

  if (bind_param->req_dst_addr == ZB_UNKNOWN_SHORT_ADDR)
  {
    TRACE_MSG(TRACE_ERROR, "get short address by ieee failed", (FMT__0));
    dev->assign_table[dev->assign_idx] = 0xFF;
    dev->assign_idx = 0xFF;
    cleanup_assign_table(light_control);
    cleanup_dev(light_control);
    return RET_IGNORE;
  }

  dev->last_zdo_tsn = zb_zdo_bind_req(buf_ref, device_bind_cb);

  if (dev->last_zdo_tsn == 0xFF)
  {
    TRACE_MSG(TRACE_ERROR, "bind request allocation failed", (FMT__0));
    cleanup_dev(dev);
    return RET_ERROR;
  }

  return RET_OK;
}

static void device_assign(zb_uint8_t buf_ref, zb_uint16_t dev_idx)
{
  zb_uint8_t i;
  simple_device_t *dev = &zc_ctx.devices[(zb_uint8_t)dev_idx];

  TRACE_MSG(TRACE_APP1, "device assign idx: %hd ieee: " TRACE_FORMAT_64, (FMT__H_A, dev_idx, TRACE_ARG_64(dev->ieee_addr)));

  for (i = 0; i < LIGHT_ZC_MAX_DEVICES; ++i)
  {
    //skip self entry
    if (i == (zb_uint8_t)dev_idx) continue;

    if (zc_ctx.devices[i].dev_type == SIMPLE_DEV_TYPE_UNUSED ||
        zc_ctx.devices[i].dev_type == SIMPLE_DEV_TYPE_UNDEFINED) continue;

    //skip assign for the same type of device
    if (dev->dev_type == zc_ctx.devices[i].dev_type) continue;

    {
      zb_uint8_t j;
      zb_uint8_t free_slot = 0xFF;

      for (j = 0; j < (LIGHT_ZC_MAX_DEVICES - 1); ++j)
      {
        if (dev->assign_table[j] != 0xFF && dev->assign_table[j] == i)
        {
          //already assigned
          break;
        }

        if (free_slot == 0xFF && dev->assign_table[j] == 0xFF)
        {
          free_slot = j;
        }
      }

      if (j < (LIGHT_ZC_MAX_DEVICES - 1))
      {
        //already assigned for this device
        continue;
      }

      if (free_slot == 0xFF)
      {
        ZB_ASSERT(0);
      }

      dev->assign_table[free_slot] = i;

      {
        zb_ret_t ret;

        dev->assign_idx = free_slot;

        if (dev->dev_type == SIMPLE_DEV_TYPE_LIGHT)
        {
          ret = device_bind(buf_ref, dev, dev, &zc_ctx.devices[dev->assign_table[dev->assign_idx]]);
        }
        else
        {
          ret = device_bind(buf_ref, dev, &zc_ctx.devices[dev->assign_table[dev->assign_idx]], dev);
        }

        if (ret == RET_IGNORE)
        {
          continue;
        }
        else
        if (ret == RET_ERROR)
        {
          break;
        }
        else
        if (ret == RET_OK)
        {
          buf_ref = 0;
        }
        else
        {
          ZB_ASSERT(0);
        }
      }
    }
  }

  if (buf_ref)
  {
    zb_buf_free(buf_ref);
  }
}

//Match device callback
static void device_match_cb(zb_uint8_t buf_ref);

//Start to match device
static void device_match(zb_uint8_t buf_ref, zb_uint16_t dev_idx)
{
  zb_bufid_t buf = buf_ref;
  zb_zdo_match_desc_param_t *req;
  simple_device_t *dev = &zc_ctx.devices[(zb_uint8_t)dev_idx];

  TRACE_MSG(TRACE_APP1, ">> device match %hd step %hd", (FMT__H_H, buf_ref, dev->match_step));

  /* match_desc_param already has allocated memory for one cluster identifier */
  req = zb_buf_initial_alloc(buf, sizeof(zb_zdo_match_desc_param_t) + (1) * sizeof(zb_uint16_t));

  req->nwk_addr = dev->short_addr;

  if (req->nwk_addr != ZB_UNKNOWN_SHORT_ADDR)
  {
    req->addr_of_interest = req->nwk_addr;
    req->profile_id = ZB_AF_HA_PROFILE_ID;

    switch (dev->match_step)
    {
      case MATCH_STEP_ON_OFF_LVL_CTRL_SERVER:
#ifdef ZC_AUTO_SEARCH_AND_BIND_LVL_CTRL_CLST
        /* We are searching for On/Off and Level Control Server */
        req->num_in_clusters = 2;
#else
        /* We are searching for On/Off Server */
        req->num_in_clusters = 1;
#endif
        req->num_out_clusters = 0;
        break;
      case MATCH_STEP_ON_OFF_LVL_CTRL_CLIENT:
        req->num_in_clusters = 0;
#ifdef ZC_AUTO_SEARCH_AND_BIND_LVL_CTRL_CLST
        /* We are searching for On/Off and Level Control Server */
        req->num_out_clusters = 2;
#else
        /* We are searching for On/Off Server */
        req->num_out_clusters = 1;
#endif
        break;

      default:
        ZB_ASSERT(0);
        break;
    };

    req->cluster_list[0] = ZB_ZCL_CLUSTER_ID_ON_OFF;
#ifdef ZC_AUTO_SEARCH_AND_BIND_LVL_CTRL_CLST
    req->cluster_list[1] = ZB_ZCL_CLUSTER_ID_LEVEL_CONTROL;
#endif

    dev->last_zdo_tsn = zb_zdo_match_desc_req(buf_ref, device_match_cb);

    if (dev->last_zdo_tsn == 0xFF)
    {
      TRACE_MSG(TRACE_ERROR, "zb_zdo_match_desc_req failed", (FMT__0));
      zb_buf_free(buf_ref);
    }
  }
  else
  {
    TRACE_MSG(TRACE_ERROR, "get short address by ieee failed", (FMT__0));
    zb_buf_free(buf_ref);
  }

  TRACE_MSG(TRACE_APP1, "<< device match", (FMT__0));
}

//Match device callback
static void device_match_cb(zb_uint8_t buf_ref)
{
  zb_bufid_t buf = buf_ref;
  zb_zdo_match_desc_resp_t *resp = (zb_zdo_match_desc_resp_t*)zb_buf_begin(buf);
  simple_device_t *dev;

  TRACE_MSG(TRACE_APP1, ">> device_match_cb buf_ref %hd, status %hd", (FMT__H_H, buf_ref, resp->status));

  dev = device_find_by_zdo_tsn(resp->tsn);

  if (dev == NULL)
  {
    zb_buf_free(buf);
    return;
  }

  dev->last_zdo_tsn = 0xFF;

  if (resp->status == ZB_ZDP_STATUS_SUCCESS)
  {
    switch (dev->match_step)
    {
      case MATCH_STEP_ON_OFF_LVL_CTRL_SERVER:
        if (resp->match_len > 0)
        {
          /* Match EP list follows right after response header */
          dev->match_ep = *(zb_uint8_t*)(resp + 1);
          dev->dev_type = SIMPLE_DEV_TYPE_LIGHT;

          TRACE_MSG(TRACE_APP1, "found light, dev_idx %hd, endpoint %hd", (FMT__H_H, ZB_ARRAY_IDX_BY_ELEM(zc_ctx.devices, dev), dev->match_ep));
          ZB_SCHEDULE_APP_CALLBACK2(device_assign, buf_ref, ZB_ARRAY_IDX_BY_ELEM(zc_ctx.devices, dev));
        }
        else
        {
          dev->match_step = MATCH_STEP_ON_OFF_LVL_CTRL_CLIENT;
          ZB_SCHEDULE_APP_CALLBACK2(device_match, buf_ref, ZB_ARRAY_IDX_BY_ELEM(zc_ctx.devices, dev));
        }
        break;
      case MATCH_STEP_ON_OFF_LVL_CTRL_CLIENT:
        if (resp->match_len > 0)
        {
          /* Match EP list follows right after response header */
          dev->match_ep = *(zb_uint8_t*)(resp + 1);
          dev->dev_type = SIMPLE_DEV_TYPE_LIGHT_CONTROL;

          TRACE_MSG(TRACE_APP1, "found light_control, dev_idx %hd, endpoint %hd", (FMT__H_H, ZB_ARRAY_IDX_BY_ELEM(zc_ctx.devices, dev), dev->match_ep));
          ZB_SCHEDULE_APP_CALLBACK2(device_assign, buf_ref, ZB_ARRAY_IDX_BY_ELEM(zc_ctx.devices, dev));
        }
        else
        {
          TRACE_MSG(TRACE_APP1, "no match found for dev_idx: %hd", (FMT__H, ZB_ARRAY_IDX_BY_ELEM(zc_ctx.devices, dev)));
          cleanup_dev(dev);
          zb_buf_free(buf);
        }
        break;
      default:
        ZB_ASSERT(0);
    };
  }
  else
  {
    cleanup_dev(dev);
    zb_buf_free(buf);
  }
}

static void device_annce_handler(zb_uint8_t buf_ref)
{
  zb_zdo_app_signal_hdr_t *sg_p = NULL;
  zb_zdo_signal_device_annce_params_t *dev_annce_params;
  simple_device_t *dev = NULL;

  zb_get_app_signal(buf_ref, &sg_p);
  dev_annce_params = ZB_ZDO_SIGNAL_GET_PARAMS(sg_p, zb_zdo_signal_device_annce_params_t);

  TRACE_MSG(TRACE_APP1, "dev_annce short_addr 0x%x", (FMT__D, dev_annce_params->device_short_addr));

  /* try to found slot for device */
  {
    zb_uint8_t i;

    for (i = 0; i < LIGHT_ZC_MAX_DEVICES; ++i)
    {
      if (zc_ctx.devices[i].dev_type == SIMPLE_DEV_TYPE_UNUSED ||
          (zc_ctx.devices[i].dev_type != SIMPLE_DEV_TYPE_UNUSED &&
           ZB_IEEE_ADDR_CMP(dev_annce_params->ieee_addr, zc_ctx.devices[i].ieee_addr)))
      {
        dev = &zc_ctx.devices[i];

        if (zc_ctx.devices[i].dev_type == SIMPLE_DEV_TYPE_UNUSED)
        {
          ZB_IEEE_ADDR_COPY(dev->ieee_addr, dev_annce_params->ieee_addr);
          dev->short_addr = dev_annce_params->device_short_addr;

          TRACE_MSG(TRACE_APP1, "device ieee: " TRACE_FORMAT_64, (FMT__A, TRACE_ARG_64(dev->ieee_addr)));
          zc_ctx.devices[i].dev_type = SIMPLE_DEV_TYPE_UNDEFINED;
        }
        break;
      }
    }
  }

  if (dev == NULL)
  {
    TRACE_MSG(TRACE_ERROR, "no free slot for new device", (FMT__0));
    zb_buf_free(buf_ref);
    return;
  }

  TRACE_MSG(TRACE_APP1, "found slot %hd for device, device type %hd", (FMT__H_H, ZB_ARRAY_IDX_BY_ELEM(zc_ctx.devices, dev), dev->dev_type));

  ZB_SCHEDULE_APP_CALLBACK2(device_match, buf_ref, ZB_ARRAY_IDX_BY_ELEM(zc_ctx.devices, dev));
}

#endif  /* ZC_AUTO_SEARCH_AND_BIND */

/* Callback to handle the stack events */
void zboss_signal_handler(zb_uint8_t param)
{
  /* Get application signal from the buffer */
  zb_zdo_app_signal_hdr_t *sg_p = NULL;
  zb_zdo_app_signal_t sig = zb_get_app_signal(param, &sg_p);

  if (ZB_GET_APP_SIGNAL_STATUS(param) == 0)
  {
    switch(sig)
    {
#ifdef DEBUG
      case ZB_DEBUG_SIGNAL_TCLK_READY:
      {
        zb_debug_signal_tclk_ready_params_t *params = ZB_ZDO_SIGNAL_GET_PARAMS(sg_p, zb_debug_signal_tclk_ready_params_t);
        zb_debug_broadcast_aps_key(params->long_addr);
      }
      break;
#endif
      case ZB_ZDO_SIGNAL_DEFAULT_START:
      case ZB_BDB_SIGNAL_DEVICE_FIRST_START:
      /* We run bdb_start_top_level_commissioning() from ZB_BDB_SIGNAL_DEVICE_REBOOT
       * as a workaround to open the network right after a device restarted. It's used only for testing.
       * DO NOT USE SUCH BEHAVIOR IN PRODUCTION!
       */
      case ZB_BDB_SIGNAL_DEVICE_REBOOT:
        TRACE_MSG(TRACE_APP1, "Device STARTED OK", (FMT__0));
        /* Turn off link key exchange if legacy device support (<ZB3.0) is needed */
        zb_bdb_set_legacy_device_support(1);
        bdb_start_top_level_commissioning(ZB_BDB_NETWORK_STEERING);
        break;

#ifdef ZC_AUTO_SEARCH_AND_BIND
      case ZB_ZDO_SIGNAL_DEVICE_ANNCE:
        TRACE_MSG(TRACE_APP1, "Device announcement signal", (FMT__0));
        ZB_SCHEDULE_APP_ALARM(device_annce_handler, param, ZB_TIME_ONE_SECOND * 5);
        param = 0;
        break;
#endif  /* ZC_AUTO_SEARCH_AND_BIND */
      default:
        TRACE_MSG(TRACE_APP1, "Unknown signal 0x%hx", (FMT__H, sig));
    }
  }
  else if (sig == ZB_ZDO_SIGNAL_PRODUCTION_CONFIG_READY)
  {
    TRACE_MSG(TRACE_APP1, "Production config is not present or invalid", (FMT__0));
  }
  else
  {
    TRACE_MSG(TRACE_ERROR, "Device started FAILED status %d", (FMT__D, ZB_GET_APP_SIGNAL_STATUS(param)));
  }

  /* Free the buffer if it is not used */
  if (param)
  {
    zb_buf_free(param);
  }
}
```

## src/light_zc.h
```c
/* ZBOSS Zigbee software protocol stack
 *
 * Copyright (c) 2012-2020 DSR Corporation, Denver CO, USA.
 * www.dsr-zboss.com
 * www.dsr-corporation.com
 * All rights reserved.
 *
 * Copyright 2026 NXP
 *
 * This is unpublished proprietary source code of DSR Corporation
 * The copyright notice does not evidence any actual or intended
 * publication of such source code.
 *
 * ZBOSS is a registered trademark of Data Storage Research LLC d/b/a DSR
 * Corporation
 *
 * Commercial Usage
 * Licensees holding valid DSR Commercial licenses may use
 * this file in accordance with the DSR Commercial License
 * Agreement provided with the Software or, alternatively, in accordance
 * with the terms contained in a written agreement between you and
 * DSR.
 */
/* PURPOSE: Header file for Light Coordinator
*/

#ifndef LIGHT_ZC_H
#define LIGHT_ZC_H 1

#include "zboss_api.h"

/* Default channel */
/* default ZIGBEE channel */
#ifndef CONFIG_ZIGBEE_CHANNEL
#define CONFIG_ZIGBEE_CHANNEL 21
#endif
#define LIGHT_ZC_CHANNEL_MASK (1l<<CONFIG_ZIGBEE_CHANNEL)
/* IEEE address of ZC */
#define LIGHT_ZC_ADDRESS {0xaa, 0xaa, 0xaa, 0xaa, 0xaa, 0xaa, 0xaa, 0xaa}

/* Enable joined device check */
#define ZC_AUTO_SEARCH_AND_BIND
#define ZC_AUTO_SEARCH_AND_BIND_LVL_CTRL_CLST

#ifdef ZC_AUTO_SEARCH_AND_BIND

/* Joined device types */
enum simple_dev_type_e
{
  SIMPLE_DEV_TYPE_UNUSED,
  SIMPLE_DEV_TYPE_UNDEFINED,
  SIMPLE_DEV_TYPE_LIGHT,
  SIMPLE_DEV_TYPE_LIGHT_CONTROL,
};

/* Level control roles enumeration */
enum simple_dev_match_step_e
{
  MATCH_STEP_ON_OFF_LVL_CTRL_SERVER,
  MATCH_STEP_ON_OFF_LVL_CTRL_CLIENT,
};

/* Binding steps enumeration */
enum simple_dev_bind_step_e
{
  BIND_STEP_ON_OFF_CLST,
#ifdef ZC_AUTO_SEARCH_AND_BIND_LVL_CTRL_CLST
  BIND_STEP_LVL_CTRL_CLST,
#endif
};

/* Maximum number of devices that can be checked */
#define LIGHT_ZC_MAX_DEVICES 2

/* Context to store joined devices */
typedef struct simple_device_s
{
  zb_uint8_t     dev_type;
  zb_uint8_t     match_step;
  zb_uint8_t     bind_step;
  zb_uint8_t     assign_idx;
  zb_uint8_t     last_zdo_tsn;
  zb_uint8_t     match_ep;
  zb_uint8_t     assign_table[LIGHT_ZC_MAX_DEVICES - 1];
  zb_uint16_t    short_addr;
  zb_ieee_addr_t ieee_addr;
} simple_device_t;

/* Global device context */
typedef struct light_zc_ctx_s
{
  simple_device_t devices[LIGHT_ZC_MAX_DEVICES];
} light_zc_ctx_t;

#endif  /* ZC_AUTO_SEARCH_AND_BIND */

#endif /* LIGHT_H */
```

## src/light_zc_hal.c
```c
/* ZBOSS Zigbee software protocol stack
 *
 * Copyright (c) 2012-2020 DSR Corporation, Denver CO, USA.
 * www.dsr-zboss.com
 * www.dsr-corporation.com
 * All rights reserved.
 *
 * This is unpublished proprietary source code of DSR Corporation
 * The copyright notice does not evidence any actual or intended
 * publication of such source code.
 *
 * ZBOSS is a registered trademark of Data Storage Research LLC d/b/a DSR
 * Corporation
 *
 * Commercial Usage
 * Licensees holding valid DSR Commercial licenses may use
 * this file in accordance with the DSR Commercial License
 * Agreement provided with the Software or, alternatively, in accordance
 * with the terms contained in a written agreement between you and
 * DSR.
 */
/* PURPOSE: Light ZC sample HAL
*/

#define ZB_TRACE_FILE_ID 40140
#include "light_zc.h"
#include "light_zc_hal.h"

#define BULB_LED_POWER 0
#define BULB_BUTTON_2 ZB_BOARD_BUTTON_1

#ifdef ZB_USE_BUTTONS

/* Private functions */
static void light_zc_hal_device_started(void)
{
  zb_osif_led_on(BULB_LED_POWER);
}

static void light_zc_hal_gpio_init(void)
{
  zb_osif_led_button_init();
}

/* Public interface */
void light_zc_hal_init(void)
{
  light_zc_hal_gpio_init();

  light_zc_hal_device_started();
}

zb_bool_t light_zc_hal_is_button_pressed(zb_uint8_t button_no)
{
  zb_bool_t ret = ZB_FALSE;
  ret = (zb_bool_t) zb_osif_button_state(button_no);
  return ret;
}

#endif /* ZB_USE_BUTTONS */
```
